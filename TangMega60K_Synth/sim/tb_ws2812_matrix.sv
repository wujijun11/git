`timescale 1ns/1ps
// Decode the output wire; mapping expectations are geometric and independent
// of the packed lookup tables supplied to the DUT below.
module ws2812_matrix_check #(
    parameter integer LAYOUT=0,
    parameter [124:0] PIXEL_KEY_MAP={
        5'd24,5'd23,5'd22,5'd21,5'd20,5'd19,5'd18,5'd17,5'd16,5'd15,
        5'd14,5'd13,5'd12,5'd11,5'd10,5'd9,5'd8,5'd7,5'd6,5'd5,
        5'd4,5'd3,5'd2,5'd1,5'd0},
    parameter [7:0] GREEN_RAW=8'hc9, BLUE_RAW=8'hb2,
    parameter [7:0] EXPECTED_GREEN=8'd32, EXPECTED_BLUE=8'd32
) (output reg done=0);
    reg clk=0;
    always #25 clk=!clk;
    reg rst_n=0;
    reg [24:0] guide_mask=0, touch_mask=0;
    wire led_data,busy,frame_done;
    ws2812_guide #(.CLK_HZ(20000000),.BRIGHTNESS(GREEN_RAW),
        .TOUCH_BRIGHTNESS(BLUE_RAW),.MAX_BRIGHTNESS(8'd32),
        .PIXEL_KEY_MAP(PIXEL_KEY_MAP)) dut(.*);

    integer frames=0;
    reg [24:0] seen_green=0,seen_blue=0;
    // Logical keys run left-to-right/top-to-bottom. LAYOUT=1 is row-serpentine;
    // LAYOUT=2 is that panel rotated 180 degrees. Tables in the top-level DUT
    // instances are deliberately literal rather than generated by this rule.
    function integer logical_key;
        input integer pixel;
        integer row,column,key;
        begin
            row=pixel/5; column=pixel%5;
            key=LAYOUT==0 ? pixel : row*5+((row%2)==1 ? 4-column : column);
            logical_key=LAYOUT==2 ? 24-key : key;
        end
    endfunction

    task check_latch;
        input reg completed;
        integer cycle;
        begin
            for(cycle=0;cycle<6000;cycle=cycle+1)begin
                if(busy || led_data || frame_done)
                    $fatal(1,"layout %0d: non-low/short 300us latch",LAYOUT);
                @(posedge clk); #1;
            end
            if(!busy || frame_done!==completed)
                $fatal(1,"layout %0d: latch completion indication wrong",LAYOUT);
        end
    endtask

    task check_frame;
        input [24:0] expected_guide,expected_touch;
        input reg mutate_inputs;
        integer pixel,bitno,cycle,high_cycles,key;
        reg fell,decoded_bit;
        reg [23:0] decoded_word,expected_word;
        begin
            if(!busy)$fatal(1,"layout %0d: frame start missing",LAYOUT);
            for(pixel=0;pixel<25;pixel=pixel+1)begin
                decoded_word=0;
                for(bitno=0;bitno<24;bitno=bitno+1)begin
                    high_cycles=0; fell=0;
                    for(cycle=0;cycle<25;cycle=cycle+1)begin
                        if(!busy || (frame_done && (pixel!=0 || bitno!=0 || cycle!=0)))
                            $fatal(1,"layout %0d: frame length/completion pulse wrong",LAYOUT);
                        if(led_data===1'b1)begin
                            if(fell)$fatal(1,"layout %0d: glitch in bit cell",LAYOUT);
                            high_cycles=high_cycles+1;
                        end else if(led_data===1'b0)fell=1;
                        else $fatal(1,"layout %0d: unknown output level",LAYOUT);
                        // Both masks change after the captured frame is under way.
                        if(mutate_inputs && pixel==4 && bitno==5 && cycle==7)begin
                            guide_mask=25'h0000001;
                            touch_mask=25'h1000000;
                        end
                        @(posedge clk); #1;
                    end
                    if(high_cycles!=6 && high_cycles!=13)
                        $fatal(1,"layout %0d: unexpected high pulse %0d clocks",LAYOUT,high_cycles);
                    decoded_bit=high_cycles==13;
                    decoded_word={decoded_word[22:0],decoded_bit};
                end
                key=logical_key(pixel);
                expected_word={expected_guide[key] ? EXPECTED_GREEN : 8'd0,
                    8'd0,expected_touch[key] ? EXPECTED_BLUE : 8'd0};
                if(decoded_word!==expected_word)
                    $fatal(1,"layout %0d pixel %0d/key %0d: got GRB %h expected %h",
                        LAYOUT,pixel,key,decoded_word,expected_word);
                if(decoded_word[23:16]!=0)seen_green[pixel]=1;
                if(decoded_word[7:0]!=0)seen_blue[pixel]=1;
            end
            if(busy || led_data || frame_done)
                $fatal(1,"layout %0d: expected exactly 25*24 bits",LAYOUT);
            frames=frames+1;
        end
    endtask

    integer key;
    initial begin
        repeat(4)begin @(posedge clk);#1;
            if(busy || led_data || frame_done)$fatal(1,"reset must hold output low");
        end
        @(negedge clk);guide_mask=25'h1;touch_mask=25'h1000000;rst_n=1;
        check_latch(0);
        // Every logical key must light exactly one mapped physical pixel in
        // each channel. Opposing guide/touch indices also exercise overlap.
        for(key=0;key<25;key=key+1)begin
            check_frame(25'b1<<key,25'b1<<(24-key),0);
            if(key<24)begin
                guide_mask=25'b1<<(key+1);touch_mask=25'b1<<(23-key);
                check_latch(1);
            end
        end
        if(seen_green!=25'h1ffffff || seen_blue!=25'h1ffffff)
            $fatal(1,"layout %0d: mapping did not visit every pixel/channel",LAYOUT);

        guide_mask=0;touch_mask=0;check_latch(1);check_frame(0,0,0);
        guide_mask=25'h1ffffff;check_latch(1);check_frame(25'h1ffffff,0,0);
        guide_mask=0;touch_mask=25'h1ffffff;
        check_latch(1);check_frame(0,25'h1ffffff,0);
        guide_mask=25'h1ffffff;
        check_latch(1);check_frame(25'h1ffffff,25'h1ffffff,1);
        check_latch(1);check_frame(25'h1,25'h1000000,0);

        // Reset while the next frame is partially transmitted; recovery must
        // begin with a fresh complete latch, then a clean all-off frame.
        check_latch(1);repeat(40)@(posedge clk);
        @(negedge clk);rst_n=0;#1;
        if(led_data)$fatal(1,"layout %0d: reset did not immediately gate low",LAYOUT);
        repeat(4)begin @(posedge clk);#1;
            if(busy || led_data || frame_done)$fatal(1,"layout %0d: reset failed",LAYOUT);
        end
        @(negedge clk);guide_mask=0;touch_mask=0;rst_n=1;
        check_latch(0);check_frame(0,0,0);
        $display("PASS WS2812 matrix layout %0d: %0d decoded frames, 25 guide/touch keys, GRB colors, cap, snapshot, reset",LAYOUT,frames);
        done=1;
    end
endmodule

// Negative cases must be rejected by the DUT, rather than silently producing
// a truncated frame or indexing beyond the fixed 25-key input masks.
module tb_ws2812_invalid_zero_count;
    ws2812_guide #(.LED_COUNT(0)) dut(.clk(1'b0),.rst_n(1'b0),
        .guide_mask(25'd0),.touch_mask(25'd0),.led_data(),.busy(),.frame_done());
    initial begin #1;$display("PARAMETER_NOT_REJECTED");$finish;end
endmodule

module tb_ws2812_invalid_large_count;
    ws2812_guide #(.LED_COUNT(26)) dut(.clk(1'b0),.rst_n(1'b0),
        .guide_mask(25'd0),.touch_mask(25'd0),.led_data(),.busy(),.frame_done());
    initial begin #1;$display("PARAMETER_NOT_REJECTED");$finish;end
endmodule

module tb_ws2812_invalid_key_map;
    ws2812_guide #(.PIXEL_KEY_MAP({
        5'd24,5'd23,5'd22,5'd21,5'd20,5'd19,5'd18,5'd17,5'd16,5'd15,
        5'd14,5'd13,5'd12,5'd11,5'd10,5'd9,5'd8,5'd7,5'd6,5'd5,
        5'd4,5'd3,5'd2,5'd1,5'd31})) dut(.clk(1'b0),.rst_n(1'b0),
        .guide_mask(25'd0),.touch_mask(25'd0),.led_data(),.busy(),.frame_done());
    initial begin #1;$display("PARAMETER_NOT_REJECTED");$finish;end
endmodule

module tb_ws2812_duplicate_key_map;
    ws2812_guide #(.PIXEL_KEY_MAP({
        5'd24,5'd23,5'd22,5'd21,5'd20,5'd19,5'd18,5'd17,5'd16,5'd15,
        5'd14,5'd13,5'd12,5'd11,5'd10,5'd9,5'd8,5'd7,5'd6,5'd5,
        5'd4,5'd3,5'd2,5'd1,5'd1})) dut(.clk(1'b0),.rst_n(1'b0),
        .guide_mask(25'd0),.touch_mask(25'd0),.led_data(),.busy(),.frame_done());
    initial begin #1;$display("PARAMETER_NOT_REJECTED");$finish;end
endmodule

module tb_ws2812_matrix;
    wire identity_done,serpentine_done,rotated_done;
    // Identity uses oversized raw brightness values to prove both channels
    // are independently limited. Other layouts use normal green32/blue16.
    ws2812_matrix_check identity(.done(identity_done));
    ws2812_matrix_check #(.LAYOUT(1),.GREEN_RAW(8'd32),.BLUE_RAW(8'd16),
        .EXPECTED_BLUE(8'd16),.PIXEL_KEY_MAP({
            5'd24,5'd23,5'd22,5'd21,5'd20,5'd15,5'd16,5'd17,5'd18,5'd19,
            5'd14,5'd13,5'd12,5'd11,5'd10,5'd5,5'd6,5'd7,5'd8,5'd9,
            5'd4,5'd3,5'd2,5'd1,5'd0})) serpentine(.done(serpentine_done));
    ws2812_matrix_check #(.LAYOUT(2),.GREEN_RAW(8'd32),.BLUE_RAW(8'd16),
        .EXPECTED_BLUE(8'd16),.PIXEL_KEY_MAP({
            5'd0,5'd1,5'd2,5'd3,5'd4,5'd9,5'd8,5'd7,5'd6,5'd5,
            5'd10,5'd11,5'd12,5'd13,5'd14,5'd19,5'd18,5'd17,5'd16,5'd15,
            5'd20,5'd21,5'd22,5'd23,5'd24})) rotated(.done(rotated_done));
    initial begin
        wait(identity_done && serpentine_done && rotated_done);
        $display("ALL WS2812 MATRIX TESTS PASSED");$finish;
    end
    initial begin #50000000;$fatal(1,"WS2812 matrix simulation watchdog");end
endmodule
